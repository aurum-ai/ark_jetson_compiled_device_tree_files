#include "tegra234-p3768-0000+p3767-0000.dts"
#include "overlay/tegra234-camera-tc358743.dtsi"

/ {
    /* Just add a custom compatible string so we can verify it loaded */
    compatible = "nvidia,p3768-0000+p3767-0000", "nvidia,p3768-0000", "nvidia,p3767-0000", "nvidia,tegra234", "test-custom-dtb";

    bus@0 {
        i2c@3180000 {
            compatible = "nvidia,tegra194-i2c";
            status = "okay";
            #address-cells = <1>;
            #size-cells = <0>;
            clock-frequency = <400000>;
            clocks = <&bpmp TEGRA234_CLK_I2C3>,
                     <&bpmp TEGRA234_CLK_PLLP_OUT0>;
            clock-names = "div-clk", "parent";
            resets = <&bpmp TEGRA234_RESET_I2C3>;
            reset-names = "i2c";
            dmas = <&gpcdma 17>, <&gpcdma 17>;
            dma-names = "rx", "tx";
        };
    };
}; 
